#include <Adafruit_GFX.h>
#include <Adafruit_SSD1306.h>
#include <Servo.h>

#define MAX_SCORE 15 

#define SCREEN_WIDTH 128 // OLED display width, in pixels
#define SCREEN_HEIGHT 64 // OLED display height, in pixels

// Knock sensor
#define KNOCK_PIN 2

// Servo
#define SERVO_PIN 6

// Reset Button
#define RESET_PIN 4


// Declaration for SSD1306 display connected using software SPI (default case):
#define OLED_MOSI   9
#define OLED_CLK   10
#define OLED_DC    11
#define OLED_CS    12
#define OLED_RESET 13
Adafruit_SSD1306 display(SCREEN_WIDTH, SCREEN_HEIGHT,
  OLED_MOSI, OLED_CLK, OLED_DC, OLED_RESET, OLED_CS);


enum servoPositions {
  SERVO_TOP= 115, 
  SERVO_LEFT = 168, 
  SERVO_RIGHT = 70 
};


Servo myservo;  
int pos = SERVO_TOP;    // variable to store the servo position
int servoDirection = 0;

int score = 0;

const unsigned char PROGMEM powPic [] = {
0x00, 0x00, 0x00, 0x00, 0x00, 0x00, 0x00, 0x00, 0x00, 0x00, 0x00, 0x00, 0x00, 0x00, 0x00, 0x00, 
0x00, 0x00, 0x00, 0x00, 0x00, 0x00, 0x00, 0x00, 0x00, 0x00, 0x00, 0x00, 0x00, 0x00, 0x00, 0x00, 
0x00, 0x00, 0x00, 0x00, 0x00, 0x00, 0x00, 0x00, 0x00, 0x00, 0x00, 0x00, 0x00, 0x00, 0x00, 0x00, 
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0x00, 0x00, 0x00, 0x00, 0x00, 0x00, 0x00, 0x00, 0x00, 0x00, 0x00, 0x00, 0x00, 0x00, 0x00, 0x00
};


const unsigned char PROGMEM winnerPic [] = {
// 'winner', 128x64px
0x00, 0x00, 0x00, 0x00, 0x00, 0x00, 0x00, 0x00, 0x00, 0x00, 0x00, 0x00, 0x00, 0x00, 0x00, 0x00, 
0x00, 0x00, 0x00, 0x00, 0x00, 0x00, 0x00, 0x00, 0x00, 0x00, 0x00, 0x00, 0x00, 0x00, 0x00, 0x00, 
0x00, 0x00, 0x00, 0x00, 0x00, 0x00, 0x00, 0x00, 0x00, 0x00, 0x00, 0x00, 0x00, 0x00, 0x00, 0x00, 
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0x00, 0x00, 0x00, 0x00, 0x00, 0x00, 0x00, 0x00, 0x00, 0x00, 0x00, 0x00, 0x00, 0x00, 0x00, 0x00
};


void setup() {

  Serial.begin(9600);
  pinMode(KNOCK_PIN, INPUT);    
  pinMode(RESET_PIN, INPUT_PULLUP);

  myservo.attach(SERVO_PIN);

  // SSD1306_SWITCHCAPVCC = generate display voltage from 3.3V internally
  if(!display.begin(SSD1306_SWITCHCAPVCC)) {
    Serial.println(F("SSD1306 allocation failed"));
    for(;;); // Don't proceed, loop forever
  }

  performResetHit();
  
  
}

void loop() {

  if (digitalRead(KNOCK_PIN)) {       // knock detected?
    performNerfHit(); 
  }
  else if (!digitalRead(RESET_PIN)) {    // reset button pressed
    performResetHit();
  }
  
}

void performNerfHit() {
  score++;
  drawBitmap(powPic);
  delay(2000);
  moveServo();
  displayScore(score, 0);
  delay(1000);
  if ( score == MAX_SCORE ) {
    delay(2000); 
    performWinner();
    performResetHit();
  }
}

void performResetHit() {
  displayScore(0,0);
  servoDirection = 0;
  score=0;
  pos = SERVO_TOP;  
  moveServo();
  delay(1000);
}

void performWinner() {
  drawBitmap(winnerPic);
  delay(20000);
}

void moveServo( ) {
 
  if (pos == SERVO_TOP) {
      if ( servoDirection == 0 ) {
         myservo.write(SERVO_TOP);
         pos = SERVO_TOP;
         servoDirection = 1;
      } else if ( servoDirection == -1 ) {
         sweepMove(SERVO_RIGHT);
      } else if ( servoDirection == 1 ) {
         sweepMove(SERVO_LEFT);
      }
  } else {
     sweepMove(SERVO_TOP);
  }
  
}

void sweepMove(servoPositions target) {
  if ( target == SERVO_RIGHT ) {
    for ( pos = pos - 1; pos >= SERVO_RIGHT; pos -= 1) {
      myservo.write(pos);
      delay(15);
    }
    servoDirection = servoDirection * -1;
  } else if ( target == SERVO_LEFT ) {
    for ( pos = pos + 1; pos <= SERVO_LEFT; pos += 1) {
      myservo.write(pos);
      delay(15);
    }
    servoDirection = servoDirection * -1;
  } else if ( target == SERVO_TOP ) {
    while ( pos != SERVO_TOP ) {
      myservo.write(pos);
      delay(15);
      pos += servoDirection;
    }
  }
}

void drawBitmap(const uint8_t *bitmap) {
  display.clearDisplay();

  display.drawBitmap(
    0,
    0,
    bitmap, SCREEN_WIDTH, SCREEN_HEIGHT, 1);
  display.display();
}

void displayScore(int score, int delayMS) {
  display.clearDisplay();
  display.setTextSize(6); // Draw 2X-scale text
  display.setTextColor(SSD1306_WHITE);
  int offset = score >= 10 ? 35 : 55;
  display.setCursor(offset, 20);
  display.println(score);
  display.display();      // Show initial text
  delay(delayMS);
}
